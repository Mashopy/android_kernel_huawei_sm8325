/dts-v1/;
/plugin/;

#include "../common/common-pm7250b.dtsi"
#include "huawei-nfc.dtsi"
#include "huawei_camera.dtsi"
#include "huawei_wifi.dtsi"
#include "huawei_storage.dtsi"
#include "huawei_dp.dtsi"
#include "huawei_charger.dtsi"
#include "huawei_bt.dtsi"
#include "huawei_rsmc.dtsi"

/ {
    /* bsp_replace_info @ model = "Huawei Technologies, Inc. %product_name%"; */
    model = "Huawei Technologies, Inc. GOA-AL80U";
    compatible = "qcom,yupik-idp", "qcom,yupik", "qcom,idp";
    /* bsp_replace_info @ qcom,board-id = <%boardid% 0>; */
    qcom,board-id = <8635 0>;
};

&rootparam {
    /* bsp_replace_info @ qcom,boardid = <%boardid_split%>; */
    /* auto_key_info @ name: boardid type: uint32 default: 0 */
    qcom,boardid = <8 6 3 5>;
    /* bsp_replace_info @ qcom,board_name = "%board_name%"; */
    qcom,board_name = "GOA_AL80U_VA";
    /* bsp_replace_info @ qcom,product_name = "%product_name%"; */
    qcom,product_name = "GOA_BID1101";
    /* bsp_replace_info @ hardware_version = "%hardware_version%"; */
    hardware_version = "HL2GOAM";
    /* bsp_replace_info @ huawei,modem_id = <%modem_id% 0x0>; */
    huawei,modem_id = <1101 0>;
};

