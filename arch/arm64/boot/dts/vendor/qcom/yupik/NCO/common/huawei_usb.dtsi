&huawei_pd {
	src_vconn = <1>; /* vbatsys */
	src_vbus = <3>; /* pmic-8350b */
	otg_ocp_check_enable = <1>;
	cc_dynamic_protect = <2>;
	quirks_fix_flag = <1>;
};

&mdss_mdp {
	connectors = <&smmu_sde_unsec &smmu_sde_sec &sde_wb &sde_dsi &sde_rscc &sde_dp>;
};

&sde_dp{
	status = "ok";
	qcom,dp-aux-switch = <&fsa4480>;
};

