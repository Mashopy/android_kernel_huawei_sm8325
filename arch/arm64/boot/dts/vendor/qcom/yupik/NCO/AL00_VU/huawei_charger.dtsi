&huawei_batt_info {
    shield_ct_sign = <1>;
};

&buck_charge {
    ffc_only_chr_done = <1>;
};

&direct_charger_sc {
	current_ratio =
		"3", "12", "25", "2", "-1",
		"0", "12", "25", "0", "0";
};

&direct_charger {
	vol_err_th = <250>;
};
