/dts-v1/;
/plugin/;

#include "../common/common-pm7250b.dtsi"
#include "huawei-nfc.dtsi"
#include "huawei_camera.dtsi"
#include "huawei_wifi.dtsi"
#include "huawei_dp.dtsi"
#include "huawei_charger.dtsi"
#include "huawei_bt.dtsi"
#include "huawei_storage.dtsi"

/ {
    /* bsp_replace_info @ model = "Huawei Technologies, Inc. %product_name%"; */
    model = "Huawei Technologies, Inc. FOA-AL00";
    compatible = "qcom,yupik-idp", "qcom,yupik", "qcom,idp";
    /* bsp_replace_info @ qcom,board-id = <%boardid% 0>; */
    qcom,board-id = <8654 0>;
};

&rootparam {
    /* bsp_replace_info @ qcom,boardid = <%boardid_split%>; */
    /* auto_key_info @ name: boardid type: uint32 default: 0 */
    qcom,boardid = <8 6 5 4>;
    /* bsp_replace_info @ qcom,board_name = "%board_name%"; */
    qcom,board_name = "FOA_AL00_VD";
    /* bsp_replace_info @ qcom,product_name = "%product_name%"; */
    qcom,product_name = "FOA_BID1100";
    /* bsp_replace_info @ hardware_version = "%hardware_version%"; */
    hardware_version = "HL2FONM";
    /* bsp_replace_info @ huawei,modem_id = <%modem_id% 0x0>; */
    huawei,modem_id = <1100 0>;
};

&soc {
    huawei_fingerprint {
        compatible = "fpc,fingerprint";
        fingerprint,avdd_en_gpio = <&tlmm 132 0>;
        avdd-supply = <>;
        fingerprint,avdd = "";
        fingerprint,avdd-min-uv = <>;
        fingerprint,avdd-max-uv = <>;
        status = "ok";
    };
};