&huawei_wifi_info{
    compatible = "huawei,hw_wifi_info";
    status = "ok";
    wifi,pubfile_id = "foa_al00_ipa";
    wifi,chiptype = "WIFI_QUALCOMM_WCN6750";
    wifi,ipa_gpio = <&tlmm 4 0x00>;
};
