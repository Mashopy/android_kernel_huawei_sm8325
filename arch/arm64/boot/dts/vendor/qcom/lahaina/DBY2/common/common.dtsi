#include "../../common/common.dtsi"
#include "huawei_audio.dtsi"
#include "huawei_charger.dtsi"
#include "huawei_antenna_board_detect.dtsi"
#include "huawei_usb.dtsi"
#include "huawei_bsp.dtsi"
#include "huawei_sensor.dtsi"
#include "huawei-lcd.dtsi"
#include "huawei_camera.dtsi"
#include "huawei_fac.dtsi"
#include "huawei_tp.dtsi"
#include "huawei_btkb_led.dtsi"
#include "huawei_pogopin.dtsi"
#include "huawei_thermal.dtsi"

&drop_sensor_enable {
    compatible = "huawei,sensorhub_drop";
    enable_drop = "1";
};
