/dts-v1/;
/plugin/;

#include "../common/common.dtsi"
#include "huawei_wifi.dtsi"
#include "huawei-bt.dtsi"
#include "../common/huawei_charger_sc.dtsi"
#include "../common/huawei_mpss.dtsi"
#include "../common/huawei_mpss_ram.dtsi"
#include "../common/huawei_ipa.dtsi"
#include "../common/huawei-gps.dtsi"
/ {
    /* bsp_replace_info @ model = "Huawei Technologies, Inc. %product_name%"; */
    model = "Huawei Technologies, Inc. DBY2-W00";
    compatible = "qcom,lahaina-qrd", "qcom,lahaina", "qcom,qrd";
    /* bsp_replace_info @ qcom,board-id = <%boardid% 0>; */
    qcom,board-id = <8121 0>;
};

&rootparam {
    /* bsp_replace_info @ qcom,boardid = <%boardid_split%>; */
    /* auto_key_info @ name: boardid type: uint32 default: 0 */
    qcom,boardid = <8 1 2 1>;
    /* bsp_replace_info @ qcom,board_name = "%board_name%"; */
    qcom,board_name = "DBY2_W00_VC";
    /* bsp_replace_info @ qcom,product_name = "%product_name%"; */
    qcom,product_name = "DBY2_BID9999";
    /* bsp_replace_info @ hardware_version = "%hardware_version%"; */
    hardware_version = "SH1DBY2LM";
    /* bsp_replace_info @ huawei,modem_id = <%modem_id% 0x0>; */
    huawei,modem_id = <9999 0>;
};

&antenna_board_detect {
        status = "disabled";
};
