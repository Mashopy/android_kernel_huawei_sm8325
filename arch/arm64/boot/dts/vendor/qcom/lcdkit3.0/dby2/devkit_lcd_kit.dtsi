/*---------------------------------------------------------------------------
 * This file is autogenerated file using huawei LCD parser. Please do not edit it.
 * Update input XML file to add a new entry or update variable in this file
 * Parser location: vendor/huawei/chipset_common/devkit/lcdkit/tools 
 *---------------------------------------------------------------------------*/


#include "dby2_190_20d_11p5_qcom.dtsi"
#include "dby2_290_20d_11p5_qcom.dtsi"
#include "dby2_dual_nt36523_video_mode_default.dtsi"