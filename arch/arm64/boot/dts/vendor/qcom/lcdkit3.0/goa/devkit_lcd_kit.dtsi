/*---------------------------------------------------------------------------
 * This file is autogenerated file using huawei LCD parser. Please do not edit it.
 * Update input XML file to add a new entry or update variable in this file
 * Parser location: vendor/huawei/chipset_common/devkit/lcdkit/tools 
 *---------------------------------------------------------------------------*/


#include "goa_190_20f_1_6p78_qcom.dtsi"
#include "goa_310_106_1_6p78_qcom.dtsi"
#include "goa_auo_otm1901a_5p2_1080p_video_default.dtsi"