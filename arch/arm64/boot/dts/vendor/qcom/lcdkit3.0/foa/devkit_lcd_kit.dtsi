/*---------------------------------------------------------------------------
 * This file is autogenerated file using huawei LCD parser. Please do not edit it.
 * Update input XML file to add a new entry or update variable in this file
 * Parser location: vendor/huawei/chipset_common/devkit/lcdkit/tools 
 *---------------------------------------------------------------------------*/


#include "foa_190_c07_6p67_qcom.dtsi"
#include "foa_290_f00_1_6p67_qcom.dtsi"
#include "foa_310_c06_1_6p67_qcom.dtsi"
#include "foa_310_d06_6p67_qcom.dtsi"
#include "foa_auo_otm1901a_5p2_1080p_video_default.dtsi"