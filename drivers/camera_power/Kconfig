## drivers/camera_power/Kconfig
```kconfig
# SPDX-License-Identifier: GPL-2.0
#
# huawei huawei camera_power module
#

config CAMERA_POWER
	tristate "huawei camera_power"
	help
	  Say m here to enable huawei camera_power module.
```
